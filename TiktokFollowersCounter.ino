#include <ESP8266WiFi.h>
#include <WiFiClientSecure.h>
#include <ESP8266HTTPClient.h>
#include <SPI.h>
#include <Wire.h>
#include <Adafruit_GFX.h>
#include <Adafruit_SSD1306.h>


#define SCREEN_WIDTH 128 
#define SCREEN_HEIGHT 64 

#define OLED_RESET     -1 
#define SCREEN_ADDRESS 0x3C 
Adafruit_SSD1306 display(SCREEN_WIDTH, SCREEN_HEIGHT, &Wire, OLED_RESET);

#define LOGO_HEIGHT   40
#define LOGO_WIDTH    40

const unsigned char logo_bmp [] PROGMEM = {
	0x00, 0x00, 0x00, 0x00, 0x00, 0x00, 0x00, 0x00, 0x00, 0x00, 0x00, 0x00, 0x00, 0x00, 0x00, 0x00, 
	0x00, 0x0f, 0xe0, 0x00, 0x00, 0x00, 0x0f, 0xe0, 0x00, 0x00, 0x00, 0x0f, 0xe0, 0x00, 0x00, 0x00, 
	0x0f, 0xe0, 0x00, 0x00, 0x00, 0x0f, 0xf0, 0x00, 0x00, 0x00, 0x0f, 0xf0, 0x00, 0x00, 0x00, 0x0f, 
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	0x00, 0x00, 0x00, 0x00, 0x00, 0x00, 0x00, 0x00
};


const unsigned char background [] PROGMEM = {
	0xff, 0xfc, 0xff, 0xff, 0xff, 0xff, 0xff, 0xff, 0xff, 0xff, 0xff, 0xff, 0xff, 0xff, 0xff, 0xff, 
	0xff, 0xf8, 0xff, 0xff, 0xff, 0xff, 0xff, 0xff, 0xff, 0xff, 0xff, 0xff, 0xff, 0xff, 0xff, 0xff, 
	0xff, 0xf9, 0xff, 0xff, 0xfc, 0x1c, 0xe7, 0xff, 0xff, 0xff, 0xc1, 0xfe, 0x73, 0xcf, 0xff, 0xff, 
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	0x52, 0xb5, 0xa9, 0x4a, 0xd6, 0xa5, 0x2b, 0x5a, 0x94, 0xad, 0x6a, 0x52, 0xb5, 0xa9, 0x4a, 0x56
};
const char* ssid = "";
const char* password = "";
const char* host = "www.tiktok.com";
const int httpsPort = 443;
const String url = "/@boilingbrains";
String followersCount;
String getFollowersCount() {
  if (WiFi.status() == WL_CONNECTED) {
    WiFiClientSecure client;
    client.setInsecure();
    if (!client.connect(host, httpsPort)) {
      Serial.println("Erreur de connexion SSL");
      return "Err";
    }
    HTTPClient http;
    http.begin(client, host, httpsPort, url);
    int httpCode = http.GET();
    if (httpCode > 0) {
      bool foundCount = false;
      int bytesRead = 0;
      const int bufferSize = 512;
      char buffer[bufferSize];
      WiFiClient *stream = http.getStreamPtr();
      while (stream->available()) {
        int n = stream->readBytes(buffer, bufferSize);
        bytesRead += n;
        String responseChunk = String(buffer);
        int countIndex = responseChunk.indexOf("data-e2e=\"followers-count\">");
        if (countIndex != -1) {
          int endIndex = responseChunk.indexOf("</strong><span data-e2e=\"followers\"", countIndex);
          if (endIndex != -1) {
            followersCount = responseChunk.substring(countIndex + 20, endIndex);
            foundCount = true;
            break;
          }
        }
      }
      if (foundCount) {
        if (followersCount.indexOf('>') != -1) {
          followersCount.remove(0, followersCount.indexOf(">") + 1);
          followersCount.trim();
        }
        Serial.print("Followers count: ");
        Serial.println(followersCount);
      } else {
        Serial.println("Line not found");
      }
    } else {
      Serial.print("Erreur HTTP : ");
      Serial.println(httpCode);
      followersCount = "Err";
    }
    http.end();
  }
  return followersCount;
}




void drawLogo(void) {
  display.drawBitmap(
    2,22,
    logo_bmp, LOGO_WIDTH, LOGO_HEIGHT, BLACK);
  display.display();
}

void setup() {
  Serial.begin(115200);
  WiFi.begin(ssid, password);
  while (WiFi.status() != WL_CONNECTED) {
    delay(1000);
    Serial.println("Connexion au WiFi...");
  }
  if(!display.begin(SSD1306_SWITCHCAPVCC, SCREEN_ADDRESS)) {
    Serial.println(F("SSD1306 allocation failed"));
    for(;;); // Don't proceed, loop forever
  };
  display.display();
    delay(2000); 
  // Clear the buffer
  display.clearDisplay();
}

void loop() {
    String followersCount = getFollowersCount();
    display.clearDisplay();
    display.drawBitmap(0, 0, background, SCREEN_WIDTH, SCREEN_HEIGHT, WHITE); 
    // display.drawBitmap(SCREEN_WIDTH - LOGO_WIDTH, 0, logo_bmp, LOGO_WIDTH, LOGO_HEIGHT, WHITE); 
    drawLogo();
    display.setCursor(50, 35);  
    display.setTextSize(2); 
    display.setTextColor(BLACK);
    display.println(followersCount);
    display.display();
    delay(21600000); 
}

